## drivers/sensors/Kconfig
```kconfig
#
# This software is contributed or developed by KYOCERA Corporation.
# (C) 2014 KYOCERA Corporation
#

config INPUT_CLASS_PRESSURE
	tristate "CLASS Pressure Sensor"
	depends on I2C
	default y

config INPUT_SENSOR_PROXIMITY
	tristate "Proximity/Light Sensor Driver"
	default y
	help
		Support Proximity/Light Sensor Driver.

config INPUT_SENSOR_PRESSURE
	tristate "Pressure Sensor Driver"
	default y
	help
		Support Pressure Sensor Driver.

config INPUT_ALPS_INPUT
        tristate "Input device driver for alps sensor"
	default y

config INPUT_HSCDTD
        tristate "GeoMagneticField device driver for I2C"
	default y

config INPUT_SENSOR_ACCELEROMETER
        tristate "Accelerometer device driver for I2C"
	default y


config SENSORS
	bool "Sensors Class Support"
	help
	  This option enables the sensor sysfs class in /sys/class/sensors.
	  You'll need this to do anything useful with sensorss. If unsure, say N.
```
